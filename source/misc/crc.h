/***************************************************************************************************
 *   Project:
 *   Author:        Stulov Tikhon
 ***************************************************************************************************
 *   Distribution:
 *
 ***************************************************************************************************
 *   MCU Family:    STM32F
 *   Compiler:      ARMCC
 ***************************************************************************************************
 *   File:          crc_macro.h
 *   Description:
 *
 ***************************************************************************************************
 *   History:       07.06.2019 - file created
 *
 **************************************************************************************************/

#pragma once

/***************************************************************************************************
 *                                      INCLUDED FILES
 **************************************************************************************************/

#include <stdlib.h>
#include <stdint.h>

#ifdef __cplusplus
    using namespace std;
#endif

/***************************************************************************************************
 *                                       DEFINITIONS
 **************************************************************************************************/

//-- стандартный расчет crc

namespace crc
{

//-- Структура установок исходных данных для расчета CRC
template<typename T> struct crc_sett_t
{
    T    poly;   ///< Полином
    T    init;   ///< Начальное значение
    bool refin;  ///< Инвертировать порядок битов входных данных
    bool refout; ///< Инвертировать контрольную сумму перед XOROUT
    T    xorout; ///< Аргумент для вычисления окончательного результата
};

//-- Переворачиваем данные
template<typename T> T ref_arg(T arg)
{
    T res;

    for (auto i = sizeof(T) * 8; i > 0; --i)
    {
        res = res << 1;
        if (arg & 1)
        {
            res |= 1;
        }
        arg >>= 1;
    }

    return res;
}

//-- Расчет CRC
template<typename T> T crc_calc(uint8_t arg, const crc_sett_t<T> &sett, T &crc)
{
    if (sett.refin)
    {
        arg = ref_arg(arg);
    }
    crc ^= static_cast<T>(arg) << (sizeof(T) * 8 - 8);

    for (auto i = 8; i > 0; --i)
    {
        crc = crc & (static_cast<T>(1) << (sizeof(T) * 8 - 1)) ? (crc << 1) ^ sett.poly : crc << 1;
    }

    if (sett.refout == true)
    {
        return ref_arg(crc) ^ sett.xorout;
    }
    else
    {
        return crc ^ sett.xorout;
    }
}

}; // namespace crc

/***************************************************************************************************
 *                                       END OF FILE
 **************************************************************************************************/
