/***************************************************************************************************
 *   Project:       
 *   Author:        Stulov Tikhon
 ***************************************************************************************************
 *   Distribution:  
 *
 ***************************************************************************************************
 *   MCU Family:    STM32F
 *   Compiler:      ARMCC
 ***************************************************************************************************
 *   File:          cpp_ms.c
 *   Description:   менеджер микросервисов
 *
 ***************************************************************************************************
 *   History:       09.12.2019 - file created
 *
 **************************************************************************************************/
 
/***************************************************************************************************
 *                                      INCLUDED FILES
 **************************************************************************************************/

#include <stdlib.h>

#include "cpp_ms.h"
#include "cpp_storage.h"
#include "sett_def.h"

using namespace std;

/***************************************************************************************************
 *                                       DEFINITIONS
 **************************************************************************************************/
 
/***************************************************************************************************
 *                                      PRIVATE TYPES
 **************************************************************************************************/
 
/***************************************************************************************************
 *                               PRIVATE FUNCTION PROTOTYPES
 **************************************************************************************************/
 
/***************************************************************************************************
 *                                       PRIVATE DATA
 **************************************************************************************************/
 
/***************************************************************************************************
 *                                       PUBLIC DATA
 **************************************************************************************************/
 
/***************************************************************************************************
 *                                      EXTERNAL DATA
 **************************************************************************************************/
 
/***************************************************************************************************
 *                              EXTERNAL FUNCTION PROTOTYPES
 **************************************************************************************************/
 
/***************************************************************************************************
 *                                    PRIVATE FUNCTIONS
 **************************************************************************************************/

//-- процесс - менеджер микросервисов
class : public cpp_os_thread<>
{
private:
    class subscriber_queue<mediator::appl_sts_t> q_appl_sts;
    
    void thread_func(void)
    {
        MS_REGIME_t reg_tmp;

        if (   true
            && sett_usr_param.service_mode.data != SERVICE_MODE_ON
            && sett_usr_param.service_mode.data != SERVICE_MODE_FIX
            )
        {
            reg_tmp = MS_REGIME_INIT;
        }
        else
        {
            reg_tmp = MS_REGIME_SERVICE;
        }

        mediator::appl_sts[APPL_STS_ID_MS_REGIME].set_if_neq({reg_tmp, APPL_STS_TYPE_U16});
    
        for(MS_REGIME_t regime = static_cast<MS_REGIME_t>(0);;)
        {
            if (q_appl_sts.get_wait_forever() == osOK)
            {
                if (   true
                    && q_appl_sts.msg.id == &mediator::appl_sts[APPL_STS_ID_MS_REGIME]
                    && regime != q_appl_sts.msg.val.value
                    )
                {
                    regime = static_cast<MS_REGIME_t>(q_appl_sts.msg.val.value);

                    cpp_ms_list::enumerate(&regime, [] (cpp_ms_list *& _el, void * _arg)
                    {
                        _el->change(*static_cast<MS_REGIME_t *>(_arg));
                        
                        return true;
                    });
                }
            }
        }
    };
    
public:
    using cpp_os_thread::cpp_os_thread;
} ms_manager = {"ms_manager"};

/***************************************************************************************************
 *                                    PUBLIC FUNCTIONS
 **************************************************************************************************/
 
/***************************************************************************************************
 *                                       END OF FILE
 **************************************************************************************************/